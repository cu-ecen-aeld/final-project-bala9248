## meta-wlan0/conf/layer.conf
```bitbake
# We have a conf and classes directory, add to BBPATH
BBPATH .= ":${LAYERDIR}"

# We have recipes-* directories, add to BBFILES
BBFILES += "${LAYERDIR}/recipes-*/*/*.bb \
            ${LAYERDIR}/recipes-*/*/*.bbappend"

BBFILE_COLLECTIONS += "meta-wlan0"
BBFILE_PATTERN_meta-wlan0 = "^${LAYERDIR}/"
BBFILE_PRIORITY_meta-wlan0 = "5"

LAYERDEPENDS_meta-wlan0 = "core"
LAYERSERIES_COMPAT_meta-wlan0 = "kirkstone"
```
